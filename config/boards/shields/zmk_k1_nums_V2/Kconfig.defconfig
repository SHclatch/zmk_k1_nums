## config/boards/shields/zmk_k1_nums_V2/Kconfig.defconfig
```kconfig
if SHIELD_ZMK_K1_NUMS_V2

config ZMK_KEYBOARD_NAME
    default "zmk_k1_nums_v2"

endif
```

## config/boards/shields/zmk_k1_nums_V2/Kconfig.shield
```kconfig
config SHIELD_ZMK_K1_NUMS_V2
    def_bool $(shields_list_contains,zmk_5x5numpads)
```
