// #include <dt-bindings/zmk/matrix_transform.h>
// #include <zephyr/dt-bindings/gpio/nordic-nrf-gpio.h>
#include "zmk_5x5numpads.dtsi"

&xiao_serial { status = "disabled"; };
&xiao_i2c { status = "disabled"; };

// / {
    // kscan0: kscan0 {
    //     compatible = "zmk,kscan-gpio-matrix";
    //     diode-direction = "col2row";
    //     wakeup-source;

    //     col-gpios
    //         = <&gpio0 2 GPIO_ACTIVE_HIGH>
    //         , <&gpio0 15 GPIO_ACTIVE_HIGH>
    //         , <&gpio0 3 GPIO_ACTIVE_HIGH>
    //         , <&gpio0 28 GPIO_ACTIVE_HIGH>
    //         , <&gpio1 1 GPIO_ACTIVE_HIGH>
    //         , <&gpio0 29 GPIO_ACTIVE_HIGH>
    //         , <&gpio0 9 GPIO_ACTIVE_HIGH>
    //         , <&gpio0 4 GPIO_ACTIVE_HIGH>
    //         ;

    //     row-gpios
    //         = <&gpio0 10 (GPIO_ACTIVE_HIGH | GPIO_PULL_DOWN)>
    //         , <&gpio0 5 (GPIO_ACTIVE_HIGH | GPIO_PULL_DOWN)>
    //         , <&gpio1 12 (GPIO_ACTIVE_HIGH | GPIO_PULL_DOWN)>
    //         , <&gpio1 11 (GPIO_ACTIVE_HIGH | GPIO_PULL_DOWN)>
    //         ;
    // };

    // default_transform: keymap_transform0 {
    //     compatible = "zmk,matrix-transform";
    //     columns = <8>; // Length of the "col-gpios" array
    //     rows = <4>; // Length of the "row-gpios" array
    //     map = <
    //     //   Key 1 | Key 2 | Key 3 | Key 4 | Key 5 | Key 6 | Key 7 | Key 8
    //         RC(0,0) RC(0,1) RC(0,2) RC(0,3) RC(0,4) RC(0,5) RC(0,6) RC(0,7)
    //     //   Key Q | Key W | Key E | Key R | Key T | Key Y | Key U | Key I
    //         RC(1,0) RC(1,1) RC(1,2) RC(1,3) RC(1,4) RC(1,5) RC(1,6) RC(1,7)
    //     //   Key A | Key S | Key D | Key F | Key G | Key H | Key J | Key K
    //         RC(2,0) RC(2,1) RC(2,2) RC(2,3) RC(2,4) RC(2,5) RC(2,6) RC(2,7)
    //     //   Key Z | Key X | Key C | Key V | Key B | Key N | Key M | Key ,
    //         RC(3,0) RC(3,1) RC(3,2) RC(3,3) RC(3,4) RC(3,5) RC(3,6) RC(3,7)
    //     >;
    // };

    // physical_layout0: physical_layout_0 { // First physical layout, use different naming for other layouts
    //     compatible = "zmk,physical-layout";
    //     display-name = "Default Layout";
    //     kscan = <&kscan0>; // Label of the kscan node, optional if all layouts use the same
    //     transform = <&default_transform>; // Label of the matrix transform for this layout
    // };

    // chosen {
    //     zmk,physical-layout = &physical_layout0;
    //     // Other chosen items
    // };
//};