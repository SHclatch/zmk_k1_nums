// #include <dt-bindings/zmk/matrix_transform.h>
// #include <zephyr/dt-bindings/gpio/nordic-nrf-gpio.h>
#include "zmk_k1_nums.dtsi"

&xiao_serial { status = "disabled"; };
&xiao_i2c { status = "disabled"; };
